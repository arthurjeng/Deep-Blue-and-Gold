// Myopic: A simple chess program for small systems
//
// Copyright (C) 2010 by chessnotation@me.com   (Some rights reserved)
//
// License: Creative Commons Attribution-Share Alike 3.0
// See: http://creativecommons.org/licenses/by-sa/3.0/
//
// Caution: No warranty; use at your own risk.

#include "Definitions.h"
#include "Constants.h"
#include "Utilities.h"

#if (IsDevHost)
#include <cassert>
#endif

#include "Board.h"
#include "SS.h"
#include "SSKnight.h"
#include "SSKing.h"
#include "Hash.h"

#if (IsTarget)
void TargetUpdateBackpackBoardDisplay(const Board& board);
#endif

void Board::Reset(void) {for (sqrType sqr = 0; sqr < sqrLen; sqr++) ResetMan(sqr);}

void Board::SetInitialArray(void)
{
  // Scan through each file

  for (fileType file = 0; file < fileLen; file++)
  {
    // Handle each color for the current file

    for (colorType color = 0; color < colorRLen; color++)
    {
      // Initialize four squares along the file for the current color

      PutMan(file, r1rank[color], synthman[color][filepiece[file]]);
      PutMan(file, r2rank[color], synthman[color][piecePawn]);
      ResetMan(file, r3rank[color]); ResetMan(file, r4rank[color]);
    };
  };
}

sqrType Board::CalcNextSquare(const sqrType frsqr, const dirType dir)
{
  // The next square along a direction is calculated (used if look-up table is absent)

  const fileType tofile = MapSqrToFile(frsqr) + filedels[dir];
  const rankType torank = MapSqrToRank(frsqr) + rankdels[dir];
  sqrType tosqr;

  // Nybble overflow/underflow detection

  if ((tofile | torank) & 0x88) tosqr = sqrNil; else tosqr = frsqr + sqrdels[dir];
  return tosqr;
}

dirType Board::CalcDirection(const sqrType frsqr, const sqrType tosqr)
{
  // The direction between two squares is calculated (used if look-up table is absent)

  dirType dir;

  if (frsqr == tosqr) dir = dirNil;
  else
  {
    const si filedelta = CalcFileDelta(frsqr, tosqr);
    const si rankdelta = CalcRankDelta(frsqr, tosqr);

    // Orthogonals

    if (rankdelta == 0) dir = (filedelta > 0) ? dirE : dirW;
    else
    {
      if (filedelta == 0) dir = (rankdelta > 0) ? dirN : dirS;
      else
      {
        // Diagonals

        if (filedelta == rankdelta) dir = (filedelta > 0) ? dirNE : dirSW;
        else
        {
          if (filedelta == -rankdelta) dir = (filedelta > 0) ? dirSE : dirNW;
          else
          {
            // Crooks (knight directions)

            if (filedelta == 2)
            {
              if (rankdelta == 1) dir = dirENE;
              else
                dir = (rankdelta == -1) ? dirESE : dirNil;
            }
            else
            {
              if (filedelta == 1)
              {
                if (rankdelta == 2) dir = dirNNE;
                else
                  dir = (rankdelta == -2) ? dirSSE : dirNil;
              }
              else
              {
                if (filedelta == -1)
                {
                  if (rankdelta == 2) dir = dirNNW;
                  else
                    dir = (rankdelta == -2) ? dirSSW : dirNil;
                }
                else
                {
                  if (filedelta == -2)
                  {
                    if (rankdelta == 1) dir = dirWNW;
                    else
                      dir = (rankdelta == -1) ? dirWSW : dirNil;
                  }
                  else
                    dir = dirNil;
                };
              };
            };
          };
        };
      };
    };
  };
  return dir;
}

bool Board::CalcAdjacent(sqrType frsqr, sqrType tosqr)
{
  // The adjacency between two squares is calculated (used if look-up table is absent)

  return
    (CalcAbsFileDelta(frsqr, tosqr) <= 1) && (CalcAbsRankDelta(frsqr, tosqr) <= 1) &&
    (frsqr != tosqr);
}

ddbType Board::CalcDDB(sqrType frsqr, sqrType tosqr)
{
  // The DD byte for two squares is calculated (used if look-up table is absent)

  ddbType ddb = 0;
  const dirType dir = CalcDirection(frsqr, tosqr);

  if (IsDirNotNil(dir))
  {
    ddb |= dir;
    if (IsDirCrook(dir)) ddb |= BX(6);
    else
    {
      if (IsDirOrtho(dir)) ddb |= BX(4); else ddb |= BX(5);
      if (CalcAdjacent(frsqr, tosqr)) ddb |= BX(7);
    };
  };
  return ddb;
}

ui Board::CalcMinFRSeparation(const sqrType frsqr, const sqrType tosqr)
{
  // The min F/R sep between two squares is calculated (used if look-up table is absent)

  const ui absfiledelta = CalcAbsFileDelta(frsqr, tosqr);
  const ui absrankdelta = CalcAbsRankDelta(frsqr, tosqr);

  return (absfiledelta < absrankdelta) ? absfiledelta : absrankdelta;
}

ui Board::CalcSumFRSeparation(const sqrType frsqr, const sqrType tosqr)
{
  // The sum f/R sep between two squares is calculated (used if look-up table is absent)

  return CalcAbsFileDelta(frsqr, tosqr) + CalcAbsRankDelta(frsqr, tosqr);
}

sdbType Board::CalcSDB(const sqrType frsqr, const sqrType tosqr)
{
  // The SD byte for two squares is calculated (used if look-up table is absent)

  return
    (sdbType)
      ((CalcSumFRSeparation(frsqr, tosqr) << 4) | CalcMinFRSeparation(frsqr, tosqr));
}

sqrType Board::LocateKing(const colorType color) const
{
  // Find the square of the king for the given color

  sqrType kingsqr = sqrNil, sqr = 0;
  const manType kingman = synthman[color][pieceKing];

  while (IsSqrNil(kingsqr) && (sqr < sqrLen))
    if (GetMan(sqr) == kingman) kingsqr = sqr; else sqr++;
  return kingsqr;
}

bool Board::ColorAttacksSquare(const colorType color, const sqrType tosqr) const
{
  // Determine if a color attacks a square

  bool atkflag = false;
  const colorType othercolor = OtherColor(color);
  const manfmType colorbit = BX(color + pieceRLen), pawnmask = colorbit | manfmPawn;
  SS ss(tosqr);
  sqrType frsqr;
  manType frman;

  // Handle orthogonal directions

  for (dirType dir = dirE; (!atkflag && (dir <= dirS)); dir++)
  {
    ss.SetDirection(dir); frsqr = ss.Advance();
    if (IsSqrNotNil(frsqr))
    {
      frman = GetMan(frsqr);
      if (IsManNotVacant(frman))
      {
        const manfmType manmask = manflags[frman];

        if ((manmask & colorbit) && (manmask & manfmOrtho)) atkflag = true;
      }
      else
      {
        do
          frsqr = ss.Advance();
        while (IsSqrNotNil(frsqr) && IsManVacant(frman = GetMan(frsqr)));
        if (IsSqrNotNil(frsqr))
        {
          const manfmType manmask = manflags[frman];

          if ((manmask & colorbit) && (manmask & manfmOrthoSweeper)) atkflag = true;
        };
      };
    };
  };

  // Handle diagonal directions

  for (dirType dir = dirNE; (!atkflag && (dir <= dirSE)); dir++)
  {
    ss.SetDirection(dir); frsqr = ss.Advance();
    if (IsSqrNotNil(frsqr))
    {
      frman = GetMan(frsqr);
      if (IsManNotVacant(frman))
      {
        const manfmType manmask = manflags[frman];

        if (manmask & colorbit)
        {
          if (manmask & manfmDiago) atkflag = true;
          else
            if ((manmask == pawnmask) && pawncolordirattack[othercolor][dir]) atkflag = true;
        };
      }
      else
      {
        do
          frsqr = ss.Advance();
        while (IsSqrNotNil(frsqr) && IsManVacant(frman = GetMan(frsqr)));
        if (IsSqrNotNil(frsqr))
        {
          const manfmType manmask = manflags[frman];

          if ((manmask & colorbit) && (manmask & manfmDiagoSweeper)) atkflag = true;
        };
      };
    };
  };

  // Handle knight directions

  if (!atkflag)
  {
    const manType knightman = synthman[color][pieceKnight];

    SSKnight ssknight(tosqr);

    while (!atkflag && IsSqrNotNil(frsqr = ssknight.Advance()))
      if (GetMan(frsqr) == knightman) atkflag = true;
  };

  return atkflag;
}

ui Board::CountColorAttacksToSquare(const colorType color, const sqrType tosqr) const
{
  // Count the number of attacks by a color to a square

  ui atkcount = 0;

  {
    // Handle orthogonal directions

    const colorType othercolor = OtherColor(color);
    const manfmType colorbit = BX(color + pieceRLen), pawnmask = colorbit | manfmPawn;
    SS ss(tosqr);
    sqrType frsqr;
    manType frman;

    for (dirType dir = dirE; dir <= dirS; dir++)
    {
      ss.SetDirection(dir); frsqr = ss.Advance();
      if (IsSqrNotNil(frsqr))
      {
        frman = GetMan(frsqr);
        if (IsManNotVacant(frman))
        {
          const manfmType manmask = manflags[frman];

          if ((manmask & colorbit) && (manmask & manfmOrtho)) atkcount++;
        }
        else
        {
          do
            frsqr = ss.Advance();
          while (IsSqrNotNil(frsqr) && IsManVacant(frman = GetMan(frsqr)));
          if (IsSqrNotNil(frsqr))
          {
            const manfmType manmask = manflags[frman];

            if ((manmask & colorbit) && (manmask & manfmOrthoSweeper)) atkcount++;
          };
        };
      };
    };

    // Handle diagonal directions

    for (dirType dir = dirNE; dir <= dirSE; dir++)
    {
      ss.SetDirection(dir); frsqr = ss.Advance();
      if (IsSqrNotNil(frsqr))
      {
        frman = GetMan(frsqr);
        if (IsManNotVacant(frman))
        {
          const manfmType manmask = manflags[frman];

          if (manmask & colorbit)
          {
            if (manmask & manfmDiago) atkcount++;
            else
              if ((manmask == pawnmask) && pawncolordirattack[othercolor][dir]) atkcount++;
          };
        }
        else
        {
          do
            frsqr = ss.Advance();
          while (IsSqrNotNil(frsqr) && IsManVacant(frman = GetMan(frsqr)));
          if (IsSqrNotNil(frsqr))
          {
            const manfmType manmask = manflags[frman];

            if ((manmask & colorbit) && (manmask & manfmDiagoSweeper)) atkcount++;
          };
        };
      };
    };
  };

  {
    // Handle knight directions

    const manType knightman = synthman[color][pieceKnight];

    SSKnight ssknight(tosqr);
    sqrType frsqr;

    while (IsSqrNotNil(frsqr = ssknight.Advance()))
      if (GetMan(frsqr) == knightman) atkcount++;
  };

  return atkcount;
}

ui Board::CountAttacksFromSquare(const sqrType sqr) const
{
  // Count the number of attacks from a square

  ui count;
  const manType man = GetMan(sqr);

  switch (cvmantopiece[man])
  {
    case piecePawn:
      count = FetchPawnAttackCount(sqr);
      break;

    case pieceKnight:
      count = FetchKnightAttackCount(sqr);
      break;

    case pieceBishop:
    case pieceRook:
    case pieceQueen:
      {
        SS ss(sqr);
        const dirType stopdir = mands1dir[man];

        count = 0;
        for (dirType dir = mands0dir[man]; dir <= stopdir; dir++)
        {
          sqrType tosqr;

          ss.SetDirection(dir);
          while (IsSqrNotNil(tosqr = ss.Advance()) && IsOccupantVacant(tosqr)) count++;
          if (IsSqrNotNil(tosqr)) count++;
        };
      };
      break;

    case pieceKing:
      count = FetchKingAttackCount(sqr);
      break;

    default:
      count = 0; SwitchFault();
      break;
  };
  return count;
}

void Board::CalcPosHash(Hash& hash) const
{
  hash.Reset();
  for (sqrType sqr = 0; sqr < sqrLen; sqr++)
  {
    const manType man = GetMan(sqr);

    if (IsManNotVacant(man)) hash.FoldManSqr(man, sqr);
  };
}

void Board::CalcPosHashRev(Hash& hash) const
{
  hash.Reset();
  for (sqrType sqr = 0; sqr < sqrLen; sqr++)
  {
    const manType man = GetMan(sqr);

    if (IsManNotVacant(man)) hash.FoldManSqr(otherman[man], OtherSqr(sqr));
  };
}

void Board::Flip(void)
{
  const Board board(*this);

  for (sqrType sqr = 0; sqr < sqrLen; sqr++)
    PutMan(OtherSqr(sqr), otherman[board.GetMan(sqr)]);
}

bool Board::IsValidDistribution(void) const
{
  // Test for neither too few nor too many men of the various piece kinds

  bool valid = true;
  colorType color;
  ui mancount[manRLen];

  // Initialize the accumulator vector

  for (manType man = 0; man < manRLen; man++) mancount[man] = 0;
  for (sqrType sqr = 0; sqr < sqrLen; sqr++)
  {
    const manType man = GetMan(sqr);

    if (IsManNotVacant(man)) mancount[man]++;
  };

  // Loop through the colors

  color = 0;
  while (valid && (color < colorRLen))
  {
    const ui kingcount = mancount[synthman[color][pieceKing]];

    if (kingcount != 1) valid = false;
    else
    {
      const ui pawncount = mancount[synthman[color][piecePawn]];

      if (pawncount > fileLen) valid = false;
      else
      {
        ui promcount = fileLen - pawncount;
        const ui queencount = mancount[synthman[color][pieceQueen]];

        if (queencount > (promcount + 1)) valid = false;
        else
        {
          if (queencount > 1) promcount -= (queencount - 1);

          const ui rookcount = mancount[synthman[color][pieceRook]];

          if (rookcount > (promcount + 2)) valid = false;
          else
          {
            if (rookcount > 2) promcount -= (rookcount - 2);

            const ui bishopcount = mancount[synthman[color][pieceBishop]];

            if (bishopcount > (promcount + 2)) valid = false;
            else
            {
              if (bishopcount > 2) promcount -= (bishopcount - 2);

              const ui knightcount = mancount[synthman[color][pieceKnight]];

              if (knightcount > (promcount + 2)) valid = false;
            };
          };
        };
      };
    };

    // Next color

    color++;
  };
  return valid;
}

bool Board::IsValidPawnLocation(void) const
{
  // Check for no pawns on the first rank or the last rank

  bool valid = true;
  fileType file = 0;

  while (valid && (file < fileLen))
    if ((GetPiece(file, rank1) == piecePawn) || (GetPiece(file, rank8) == piecePawn))
      valid = false;
    else
      file++;
  return valid;
}

bool Board::IsValid(void) const {return IsValidDistribution() && IsValidPawnLocation();}

void Board::RedrawBoardDisplay(void) const
{
  // Target dependent hardware display update

#if (IsTarget)
  TargetUpdateBackpackBoardDisplay(*this);
#endif
}

bool Board::IsSane(void) const
{
  // Simple sanity checking for a board

  bool okay = true;

  // Test scalar ranges

  if (okay)
  {
    for (sqrType sqr = 0; okay && (sqr < sqrLen); sqr++)
    {
      const manType man = GetMan(sqr);

      if ((man < 0) || (man > manVacant)) okay = false;
    };
  };

  // Test validity

  if (okay && !IsValid()) okay = false;

  return okay;
}

void Board::PrintMPD(void) const
{
  // Output the Man Placement Data (i.e., the first FEN field)

  for (rankType rank = rank8; rank >= rank1; rank--)
  {
    ui spaces = 0;

    for (fileType file = 0; file < fileLen; file++)
    {
      const manType man = GetMan(file, rank);

      if (IsManVacant(man)) spaces++;
      else
      {
        if (spaces) {PrintDigit(spaces); spaces = 0;};
        PrintManMPD(man);
      };
    };
    if (spaces) PrintDigit(spaces);
    if (rank != rank1) PrintChar('/');
  };
}

void Board::PrintGraphicSqrContent(const sqrType sqr) const
{
  // Output a single square far a board display

  const manType man = GetMan(sqr);

  if (IsManNotVacant(man)) PrintMan(man);
  else
  {
    if (IsSqrWhite(sqr)) PrintFS(fsMsSqWhite); else PrintFS(fsMsSqBlack);
  };
}

void Board::PrintGraphic(const bool normal) const
{
  // Print the upper file labels

  PrintSpaces(2);
  for (fileType file = 0; file < fileLen; file++)
  {
    PrintFile(normal ? file: OtherFile(file)); PrintSpace();
  };
  PrintNL();

  // Print the ranks

  for (rankType rank = (rankLen - 1); rank >= 0; rank--)
  {
    // Print the opening rank digit label

    PrintRank(normal ? rank : OtherRank(rank)); PrintSpace();

    // Print a row of square contents

    for (fileType file = 0; file < fileLen; file++)
      PrintGraphicSqrContent(
        MapFileRankToSqr(
          (normal ? file : OtherFile(file)),
          (normal ? rank : OtherRank(rank))));

    // Print the closing rank digit label and newline

    PrintSpace(); PrintRank(normal ? rank : OtherRank(rank)); PrintNL();
  };

  // Print the lower file labels

  PrintSpaces(2);
  for (fileType file = 0; file < fileLen; file++)
  {
    PrintFile(normal ? file: OtherFile(file)); PrintSpace();
  };
  PrintNL();
}

// Map man/sweep to attack ability

const ui8 Board::mansweepflag[mansweepflagLen] PROGMEM =
{
  0, 0, 0, 0, 0, 0, 0, 0,
  0, 0, 0, 0, 0, 0, 0, 0,
  0, 0, 0, 0, 1, 1, 1, 1,
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  0, 0, 0, 0, 0, 0, 0, 0
};

// Center tropism distance

const ui8 Board::centertropismdistance[sqrLen] PROGMEM =
{
  255, 222, 196, 182, 182, 196, 222, 255,
  222, 182, 150, 131, 131, 150, 182, 222,
  196, 150, 109,  81,  81, 109, 150, 196,
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  255, 222, 196, 182, 182, 196, 222, 255
};

// Count of pawn attacks from a square (either color)

const ui8 Board::pawnattackcount[sqrLen] PROGMEM =
{
  0, 0, 0, 0, 0, 0, 0, 0,
  1, 2, 2, 2, 2, 2, 2, 1,
  1, 2, 2, 2, 2, 2, 2, 1,
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  0, 0, 0, 0, 0, 0, 0, 0
};

// Count of knight attacks from a square

const ui8 Board::knightattackcount[sqrLen] PROGMEM =
{
  2, 3, 4, 4, 4, 4, 3, 2,
  3, 4, 6, 6, 6, 6, 4, 3,
  4, 6, 8, 8, 8, 8, 6, 4,
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  2, 3, 4, 4, 4, 4, 3, 2
};

// Count of king attacks from a square

const ui8 Board::kingattackcount[sqrLen] PROGMEM =
{
  3, 5, 5, 5, 5, 5, 5, 3,
  5, 8, 8, 8, 8, 8, 8, 5,
  5, 8, 8, 8, 8, 8, 8, 5,
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  3, 5, 5, 5, 5, 5, 5, 3
};

// Map initial square and direction to next square

const sqrType Board::sqrdirtosqr[sqrdirLen] PROGMEM =
{
  sqrB1,  sqrA2,  sqrNil, sqrNil, sqrB2,  sqrNil, sqrNil, sqrNil, sqrC2,  sqrB3,  sqrNil, sqrNil, sqrNil, sqrNil, sqrNil, sqrNil,
  sqrC1,  sqrB2,  sqrA1,  sqrNil, sqrC2,  sqrA2,  sqrNil, sqrNil, sqrD2,  sqrC3,  sqrA3,  sqrNil, sqrNil, sqrNil, sqrNil, sqrNil,
  sqrD1,  sqrC2,  sqrB1,  sqrNil, sqrD2,  sqrB2,  sqrNil, sqrNil, sqrE2,  sqrD3,  sqrB3,  sqrA2,  sqrNil, sqrNil, sqrNil, sqrNil,
  sqrE1,  sqrD2,  sqrC1,  sqrNil, sqrE2,  sqrC2,  sqrNil, sqrNil, sqrF2,  sqrE3,  sqrC3,  sqrB2,  sqrNil, sqrNil, sqrNil, sqrNil,
  sqrF1,  sqrE2,  sqrD1,  sqrNil, sqrF2,  sqrD2,  sqrNil, sqrNil, sqrG2,  sqrF3,  sqrD3,  sqrC2,  sqrNil, sqrNil, sqrNil, sqrNil,
  sqrG1,  sqrF2,  sqrE1,  sqrNil, sqrG2,  sqrE2,  sqrNil, sqrNil, sqrH2,  sqrG3,  sqrE3,  sqrD2,  sqrNil, sqrNil, sqrNil, sqrNil,
  sqrH1,  sqrG2,  sqrF1,  sqrNil, sqrH2,  sqrF2,  sqrNil, sqrNil, sqrNil, sqrH3,  sqrF3,  sqrE2,  sqrNil, sqrNil, sqrNil, sqrNil,
  sqrNil, sqrH2,  sqrG1,  sqrNil, sqrNil, sqrG2,  sqrNil, sqrNil, sqrNil, sqrNil, sqrG3,  sqrF2,  sqrNil, sqrNil, sqrNil, sqrNil,

  sqrB2,  sqrA3,  sqrNil, sqrA1,  sqrB3,  sqrNil, sqrNil, sqrB1,  sqrC3,  sqrB4,  sqrNil, sqrNil, sqrNil, sqrNil, sqrNil, sqrC1,
  sqrC2,  sqrB3,  sqrA2,  sqrB1,  sqrC3,  sqrA3,  sqrA1,  sqrC1,  sqrD3,  sqrC4,  sqrA4,  sqrNil, sqrNil, sqrNil, sqrNil, sqrD1,
  sqrD2,  sqrC3,  sqrB2,  sqrC1,  sqrD3,  sqrB3,  sqrB1,  sqrD1,  sqrE3,  sqrD4,  sqrB4,  sqrA3,  sqrA1,  sqrNil, sqrNil, sqrE1,
  sqrE2,  sqrD3,  sqrC2,  sqrD1,  sqrE3,  sqrC3,  sqrC1,  sqrE1,  sqrF3,  sqrE4,  sqrC4,  sqrB3,  sqrB1,  sqrNil, sqrNil, sqrF1,
  sqrF2,  sqrE3,  sqrD2,  sqrE1,  sqrF3,  sqrD3,  sqrD1,  sqrF1,  sqrG3,  sqrF4,  sqrD4,  sqrC3,  sqrC1,  sqrNil, sqrNil, sqrG1,
  sqrG2,  sqrF3,  sqrE2,  sqrF1,  sqrG3,  sqrE3,  sqrE1,  sqrG1,  sqrH3,  sqrG4,  sqrE4,  sqrD3,  sqrD1,  sqrNil, sqrNil, sqrH1,
  sqrH2,  sqrG3,  sqrF2,  sqrG1,  sqrH3,  sqrF3,  sqrF1,  sqrH1,  sqrNil, sqrH4,  sqrF4,  sqrE3,  sqrE1,  sqrNil, sqrNil, sqrNil,
  sqrNil, sqrH3,  sqrG2,  sqrH1,  sqrNil, sqrG3,  sqrG1,  sqrNil, sqrNil, sqrNil, sqrG4,  sqrF3,  sqrF1,  sqrNil, sqrNil, sqrNil,

  sqrB3,  sqrA4,  sqrNil, sqrA2,  sqrB4,  sqrNil, sqrNil, sqrB2,  sqrC4,  sqrB5,  sqrNil, sqrNil, sqrNil, sqrNil, sqrB1,  sqrC2,
  sqrC3,  sqrB4,  sqrA3,  sqrB2,  sqrC4,  sqrA4,  sqrA2,  sqrC2,  sqrD4,  sqrC5,  sqrA5,  sqrNil, sqrNil, sqrA1,  sqrC1,  sqrD2,
  sqrD3,  sqrC4,  sqrB3,  sqrC2,  sqrD4,  sqrB4,  sqrB2,  sqrD2,  sqrE4,  sqrD5,  sqrB5,  sqrA4,  sqrA2,  sqrB1,  sqrD1,  sqrE2,
  sqrE3,  sqrD4,  sqrC3,  sqrD2,  sqrE4,  sqrC4,  sqrC2,  sqrE2,  sqrF4,  sqrE5,  sqrC5,  sqrB4,  sqrB2,  sqrC1,  sqrE1,  sqrF2,
  sqrF3,  sqrE4,  sqrD3,  sqrE2,  sqrF4,  sqrD4,  sqrD2,  sqrF2,  sqrG4,  sqrF5,  sqrD5,  sqrC4,  sqrC2,  sqrD1,  sqrF1,  sqrG2,
  sqrG3,  sqrF4,  sqrE3,  sqrF2,  sqrG4,  sqrE4,  sqrE2,  sqrG2,  sqrH4,  sqrG5,  sqrE5,  sqrD4,  sqrD2,  sqrE1,  sqrG1,  sqrH2,
  sqrH3,  sqrG4,  sqrF3,  sqrG2,  sqrH4,  sqrF4,  sqrF2,  sqrH2,  sqrNil, sqrH5,  sqrF5,  sqrE4,  sqrE2,  sqrF1,  sqrH1,  sqrNil,
  sqrNil, sqrH4,  sqrG3,  sqrH2,  sqrNil, sqrG4,  sqrG2,  sqrNil, sqrNil, sqrNil, sqrG5,  sqrF4,  sqrF2,  sqrG1,  sqrNil, sqrNil,

  sqrB4,  sqrA5,  sqrNil, sqrA3,  sqrB5,  sqrNil, sqrNil, sqrB3,  sqrC5,  sqrB6,  sqrNil, sqrNil, sqrNil, sqrNil, sqrB2,  sqrC3,
  sqrC4,  sqrB5,  sqrA4,  sqrB3,  sqrC5,  sqrA5,  sqrA3,  sqrC3,  sqrD5,  sqrC6,  sqrA6,  sqrNil, sqrNil, sqrA2,  sqrC2,  sqrD3,
  sqrD4,  sqrC5,  sqrB4,  sqrC3,  sqrD5,  sqrB5,  sqrB3,  sqrD3,  sqrE5,  sqrD6,  sqrB6,  sqrA5,  sqrA3,  sqrB2,  sqrD2,  sqrE3,
  sqrE4,  sqrD5,  sqrC4,  sqrD3,  sqrE5,  sqrC5,  sqrC3,  sqrE3,  sqrF5,  sqrE6,  sqrC6,  sqrB5,  sqrB3,  sqrC2,  sqrE2,  sqrF3,
  sqrF4,  sqrE5,  sqrD4,  sqrE3,  sqrF5,  sqrD5,  sqrD3,  sqrF3,  sqrG5,  sqrF6,  sqrD6,  sqrC5,  sqrC3,  sqrD2,  sqrF2,  sqrG3,
  sqrG4,  sqrF5,  sqrE4,  sqrF3,  sqrG5,  sqrE5,  sqrE3,  sqrG3,  sqrH5,  sqrG6,  sqrE6,  sqrD5,  sqrD3,  sqrE2,  sqrG2,  sqrH3,
  sqrH4,  sqrG5,  sqrF4,  sqrG3,  sqrH5,  sqrF5,  sqrF3,  sqrH3,  sqrNil, sqrH6,  sqrF6,  sqrE5,  sqrE3,  sqrF2,  sqrH2,  sqrNil,
  sqrNil, sqrH5,  sqrG4,  sqrH3,  sqrNil, sqrG5,  sqrG3,  sqrNil, sqrNil, sqrNil, sqrG6,  sqrF5,  sqrF3,  sqrG2,  sqrNil, sqrNil,

  sqrB5,  sqrA6,  sqrNil, sqrA4,  sqrB6,  sqrNil, sqrNil, sqrB4,  sqrC6,  sqrB7,  sqrNil, sqrNil, sqrNil, sqrNil, sqrB3,  sqrC4,
  sqrC5,  sqrB6,  sqrA5,  sqrB4,  sqrC6,  sqrA6,  sqrA4,  sqrC4,  sqrD6,  sqrC7,  sqrA7,  sqrNil, sqrNil, sqrA3,  sqrC3,  sqrD4,
  sqrD5,  sqrC6,  sqrB5,  sqrC4,  sqrD6,  sqrB6,  sqrB4,  sqrD4,  sqrE6,  sqrD7,  sqrB7,  sqrA6,  sqrA4,  sqrB3,  sqrD3,  sqrE4,
  sqrE5,  sqrD6,  sqrC5,  sqrD4,  sqrE6,  sqrC6,  sqrC4,  sqrE4,  sqrF6,  sqrE7,  sqrC7,  sqrB6,  sqrB4,  sqrC3,  sqrE3,  sqrF4,
  sqrF5,  sqrE6,  sqrD5,  sqrE4,  sqrF6,  sqrD6,  sqrD4,  sqrF4,  sqrG6,  sqrF7,  sqrD7,  sqrC6,  sqrC4,  sqrD3,  sqrF3,  sqrG4,
  sqrG5,  sqrF6,  sqrE5,  sqrF4,  sqrG6,  sqrE6,  sqrE4,  sqrG4,  sqrH6,  sqrG7,  sqrE7,  sqrD6,  sqrD4,  sqrE3,  sqrG3,  sqrH4,
  sqrH5,  sqrG6,  sqrF5,  sqrG4,  sqrH6,  sqrF6,  sqrF4,  sqrH4,  sqrNil, sqrH7,  sqrF7,  sqrE6,  sqrE4,  sqrF3,  sqrH3,  sqrNil,
  sqrNil, sqrH6,  sqrG5,  sqrH4,  sqrNil, sqrG6,  sqrG4,  sqrNil, sqrNil, sqrNil, sqrG7,  sqrF6,  sqrF4,  sqrG3,  sqrNil, sqrNil,

  sqrB6,  sqrA7,  sqrNil, sqrA5,  sqrB7,  sqrNil, sqrNil, sqrB5,  sqrC7,  sqrB8,  sqrNil, sqrNil, sqrNil, sqrNil, sqrB4,  sqrC5,
  sqrC6,  sqrB7,  sqrA6,  sqrB5,  sqrC7,  sqrA7,  sqrA5,  sqrC5,  sqrD7,  sqrC8,  sqrA8,  sqrNil, sqrNil, sqrA4,  sqrC4,  sqrD5,
  sqrD6,  sqrC7,  sqrB6,  sqrC5,  sqrD7,  sqrB7,  sqrB5,  sqrD5,  sqrE7,  sqrD8,  sqrB8,  sqrA7,  sqrA5,  sqrB4,  sqrD4,  sqrE5,
  sqrE6,  sqrD7,  sqrC6,  sqrD5,  sqrE7,  sqrC7,  sqrC5,  sqrE5,  sqrF7,  sqrE8,  sqrC8,  sqrB7,  sqrB5,  sqrC4,  sqrE4,  sqrF5,
  sqrF6,  sqrE7,  sqrD6,  sqrE5,  sqrF7,  sqrD7,  sqrD5,  sqrF5,  sqrG7,  sqrF8,  sqrD8,  sqrC7,  sqrC5,  sqrD4,  sqrF4,  sqrG5,
  sqrG6,  sqrF7,  sqrE6,  sqrF5,  sqrG7,  sqrE7,  sqrE5,  sqrG5,  sqrH7,  sqrG8,  sqrE8,  sqrD7,  sqrD5,  sqrE4,  sqrG4,  sqrH5,
  sqrH6,  sqrG7,  sqrF6,  sqrG5,  sqrH7,  sqrF7,  sqrF5,  sqrH5,  sqrNil, sqrH8,  sqrF8,  sqrE7,  sqrE5,  sqrF4,  sqrH4,  sqrNil,
  sqrNil, sqrH7,  sqrG6,  sqrH5,  sqrNil, sqrG7,  sqrG5,  sqrNil, sqrNil, sqrNil, sqrG8,  sqrF7,  sqrF5,  sqrG4,  sqrNil, sqrNil,

  sqrB7,  sqrA8,  sqrNil, sqrA6,  sqrB8,  sqrNil, sqrNil, sqrB6,  sqrC8,  sqrNil, sqrNil, sqrNil, sqrNil, sqrNil, sqrB5,  sqrC6,
  sqrC7,  sqrB8,  sqrA7,  sqrB6,  sqrC8,  sqrA8,  sqrA6,  sqrC6,  sqrD8,  sqrNil, sqrNil, sqrNil, sqrNil, sqrA5,  sqrC5,  sqrD6,
  sqrD7,  sqrC8,  sqrB7,  sqrC6,  sqrD8,  sqrB8,  sqrB6,  sqrD6,  sqrE8,  sqrNil, sqrNil, sqrA8,  sqrA6,  sqrB5,  sqrD5,  sqrE6,
  sqrE7,  sqrD8,  sqrC7,  sqrD6,  sqrE8,  sqrC8,  sqrC6,  sqrE6,  sqrF8,  sqrNil, sqrNil, sqrB8,  sqrB6,  sqrC5,  sqrE5,  sqrF6,
  sqrF7,  sqrE8,  sqrD7,  sqrE6,  sqrF8,  sqrD8,  sqrD6,  sqrF6,  sqrG8,  sqrNil, sqrNil, sqrC8,  sqrC6,  sqrD5,  sqrF5,  sqrG6,
  sqrG7,  sqrF8,  sqrE7,  sqrF6,  sqrG8,  sqrE8,  sqrE6,  sqrG6,  sqrH8,  sqrNil, sqrNil, sqrD8,  sqrD6,  sqrE5,  sqrG5,  sqrH6,
  sqrH7,  sqrG8,  sqrF7,  sqrG6,  sqrH8,  sqrF8,  sqrF6,  sqrH6,  sqrNil, sqrNil, sqrNil, sqrE8,  sqrE6,  sqrF5,  sqrH5,  sqrNil,
  sqrNil, sqrH8,  sqrG7,  sqrH6,  sqrNil, sqrG8,  sqrG6,  sqrNil, sqrNil, sqrNil, sqrNil, sqrF8,  sqrF6,  sqrG5,  sqrNil, sqrNil,

  sqrB8,  sqrNil, sqrNil, sqrA7,  sqrNil, sqrNil, sqrNil, sqrB7,  sqrNil, sqrNil, sqrNil, sqrNil, sqrNil, sqrNil, sqrB6,  sqrC7,
  sqrC8,  sqrNil, sqrA8,  sqrB7,  sqrNil, sqrNil, sqrA7,  sqrC7,  sqrNil, sqrNil, sqrNil, sqrNil, sqrNil, sqrA6,  sqrC6,  sqrD7,
  sqrD8,  sqrNil, sqrB8,  sqrC7,  sqrNil, sqrNil, sqrB7,  sqrD7,  sqrNil, sqrNil, sqrNil, sqrNil, sqrA7,  sqrB6,  sqrD6,  sqrE7,
  sqrE8,  sqrNil, sqrC8,  sqrD7,  sqrNil, sqrNil, sqrC7,  sqrE7,  sqrNil, sqrNil, sqrNil, sqrNil, sqrB7,  sqrC6,  sqrE6,  sqrF7,
  sqrF8,  sqrNil, sqrD8,  sqrE7,  sqrNil, sqrNil, sqrD7,  sqrF7,  sqrNil, sqrNil, sqrNil, sqrNil, sqrC7,  sqrD6,  sqrF6,  sqrG7,
  sqrG8,  sqrNil, sqrE8,  sqrF7,  sqrNil, sqrNil, sqrE7,  sqrG7,  sqrNil, sqrNil, sqrNil, sqrNil, sqrD7,  sqrE6,  sqrG6,  sqrH7,
  sqrH8,  sqrNil, sqrF8,  sqrG7,  sqrNil, sqrNil, sqrF7,  sqrH7,  sqrNil, sqrNil, sqrNil, sqrNil, sqrE7,  sqrF6,  sqrH6,  sqrNil,
  sqrNil, sqrNil, sqrG8,  sqrH7,  sqrNil, sqrNil, sqrG7,  sqrNil, sqrNil, sqrNil, sqrNil, sqrNil, sqrF7,  sqrG6,  sqrNil, sqrNil
};

// Map first and second squares to a direction descriptor byte

const ddbType Board::sqrsqrtoddb[sqrsqrLen] PROGMEM =
{
  0x00, 0x90, 0x10, 0x10, 0x10, 0x10, 0x10, 0x10, 0x91, 0xa4, 0x48, 0x00, 0x00, 0x00, 0x00, 0x00,
  0x11, 0x49, 0x24, 0x00, 0x00, 0x00, 0x00, 0x00, 0x11, 0x00, 0x00, 0x24, 0x00, 0x00, 0x00, 0x00,
  0x11, 0x00, 0x00, 0x00, 0x24, 0x00, 0x00, 0x00, 0x11, 0x00, 0x00, 0x00, 0x00, 0x24, 0x00, 0x00,
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  0x00, 0x00, 0x00, 0x00, 0x00, 0x4c, 0xa6, 0x93, 0x12, 0x12, 0x12, 0x12, 0x12, 0x12, 0x92, 0x00
};

// Map first and second squares to a separation descriptor byte

const sdbType Board::sqrsqrtosdb[sqrsqrLen] PROGMEM =
{
  0x00, 0x10, 0x20, 0x30, 0x40, 0x50, 0x60, 0x70, 0x10, 0x21, 0x31, 0x41, 0x51, 0x61, 0x71, 0x81,
  0x20, 0x31, 0x42, 0x52, 0x62, 0x72, 0x82, 0x92, 0x30, 0x41, 0x52, 0x63, 0x73, 0x83, 0x93, 0xa3,
  0x40, 0x51, 0x62, 0x73, 0x84, 0x94, 0xa4, 0xb4, 0x50, 0x61, 0x72, 0x83, 0x94, 0xa5, 0xb5, 0xc5,
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  0x81, 0x71, 0x61, 0x51, 0x41, 0x31, 0x21, 0x10, 0x70, 0x60, 0x50, 0x40, 0x30, 0x20, 0x10, 0x00
};
